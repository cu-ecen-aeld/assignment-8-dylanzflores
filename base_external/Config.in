## base_external/Config.in
```kconfig
source "aesd-assignments/Config.in"
source "ldd/Config.in"
source "aesd-char-driver/Config.in"
```

## base_external/package/aesd-assignments/Config.in
```kconfig
config BR2_PACKAGE_AESD_ASSIGNMENTS
    bool "AESD Assignments"
    help
      Build the AESD assignment programs and modules.
```

## base_external/package/aesd-char-driver/Config.in
```kconfig
config BR2_PACKAGE_AESD_CHAR_DRIVER
    bool "AESD Char Driver"
    help
      Build the AESD character device driver.
```

## base_external/package/ldd/Config.in
```kconfig
config BR2_PACKAGE_LDD
    bool "LDD Programs"
    help
      Build LDD example programs.
```
